AUTOSAR XML (schema 4-1-1)
package /BSW_pkg
  module config IoHwAb: implementation-config-variant=VARIANT-PRE-COMPILE, module-description=IoHwAb
    ArcIoHwAbEMS (ArcIoHwAbGeneral): ArcIoHwAbDevErrorDetect=0, ArcIoHwAbAnalogMaxVoltage=5.0, ArcIoHwAbUsePort=1, ArcIoHwCalibrationEnabled=0
    5 x ArcIoHwAbScaling, all with ArcIoHwAbScalingOffset=0.0:
      Voltage_0_5V: ArcIoHwAbScalingScale=1.0, ArcIoHwAbScalingType=Volt
      Voltage_0_6V: ArcIoHwAbScalingScale=1.2, ArcIoHwAbScalingType=Volt
      Current_over_270ohm: ArcIoHwAbScalingScale=4.115, ArcIoHwAbScalingType=Volt
      Voltage_0_10V: ArcIoHwAbScalingScale=2.0, ArcIoHwAbScalingType=Volt
      Current_over_55mohm: ArcIoHwAbScalingScale=18.18181818, ArcIoHwAbScalingType=Ampere
    IOPinConv (ArcIoHwAbExternalDeviceDriver): ArcIoHwAbDigitalSupport=true, ArcIoHwAbAnalogSupport=true, ArcIoHwAbPwmSupport=false, ArcIoHwAbExternalDeviceAnalogMaxValue=5
    Voltage_0_8dot5V (ArcIoHwAbScaling): ArcIoHwAbScalingOffset=0.0, ArcIoHwAbScalingScale=1.7, ArcIoHwAbScalingType=Volt
    NoScale (ArcIoHwAbScaling): ArcIoHwAbScalingOffset=0.0, ArcIoHwAbScalingScale=1, ArcIoHwAbScalingType=Volt
    ANALOG_B025 (ArcIoHwAbAnalogSignal):
      ArcIoHwAbAnalogDefaultValue = 0.0
      ArcIoHwAbAnalogSignalResolution = 12_BIT_RESOLUTION
      ArcIoHwAbAnalogType = IOHWAB_ADC
      ArcIoHwAbScalingRef = Voltage_0_5V
      ArcIoHwAbAdcChannel = AdcChannel_B25
      ArcIoHwAbAdcGroup = HWU5_Background
    HBRIDGE_B082_B081 (ArcIoHwAbPwmSignal): ArcIoHwAbPwmType=IOHWAB_EXTERNAL_DEVICE_PWM_FREQUENCY_AND_DUTY, ArcIoHwAbPwmDutyDefaultValue=0, ArcIoHwAbExternalDeviceDriverRef=GTM_PWM
    GTM_PWM (ArcIoHwAbExternalDeviceDriver): ArcIoHwAbDigitalSupport=false, ArcIoHwAbAnalogSupport=false, ArcIoHwAbPwmSupport=true
    3 x ArcIoHwAbPwmSignal, all with ArcIoHwAbPwmType=IOHWAB_EXTERNAL_DEVICE_PWM_FREQUENCY_AND_DUTY, ArcIoHwAbPwmDutyDefaultValue=0, ArcIoHwAbExternalDeviceDriverRef=GTM_PWM:
      HBRIDGE_B091_B086
      HBRIDGE_A045_A044
      HBRIDGE_A079_A080
    29 x ArcIoHwAbAnalogSignal, all with ArcIoHwAbAnalogDefaultValue=0.0, ArcIoHwAbAnalogSignalResolution=12_BIT_RESOLUTION:
      ANALOG_B027: ArcIoHwAbAnalogType=IOHWAB_ADC, ArcIoHwAbScalingRef=Voltage_0_5V, ArcIoHwAbAdcChannel=AdcChannel_B27, ArcIoHwAbAdcGroup=HWU3_Queued
      ANALOG_B028: ArcIoHwAbAnalogType=IOHWAB_ADC, ArcIoHwAbScalingRef=Voltage_0_5V, ArcIoHwAbAdcChannel=AdcChannel_B28, ArcIoHwAbAdcGroup=HWU3_Queued
      ANALOG_B049: ArcIoHwAbAnalogType=IOHWAB_ADC, ArcIoHwAbScalingRef=Voltage_0_5V, ArcIoHwAbAdcChannel=AdcChannel_B49, ArcIoHwAbAdcGroup=HWU0_Background
      ANALOG_B048: ArcIoHwAbAnalogType=IOHWAB_ADC, ArcIoHwAbScalingRef=Voltage_0_5V, ArcIoHwAbAdcChannel=AdcChannel_B48, ArcIoHwAbAdcGroup=HWU0_Background
      ANALOG_B046: ArcIoHwAbAnalogType=IOHWAB_ADC, ArcIoHwAbScalingRef=Voltage_0_5V, ArcIoHwAbAdcChannel=AdcChannel_B46, ArcIoHwAbAdcGroup=HWU0_Background
      ANALOG_B047: ArcIoHwAbAnalogType=IOHWAB_ADC, ArcIoHwAbScalingRef=Voltage_0_5V, ArcIoHwAbAdcChannel=AdcChannel_B47, ArcIoHwAbAdcGroup=HWU0_Background
      ANALOG_B038: ArcIoHwAbAnalogType=IOHWAB_ADC, ArcIoHwAbScalingRef=Voltage_0_5V, ArcIoHwAbAdcChannel=AdcChannel_B38, ArcIoHwAbAdcGroup=HWU0_Background
      ANALOG_B035: ArcIoHwAbAnalogType=IOHWAB_ADC, ArcIoHwAbScalingRef=Voltage_0_5V, ArcIoHwAbAdcChannel=AdcChannel_B35, ArcIoHwAbAdcGroup=HWU1_Background
      ANALOG_B036: ArcIoHwAbAnalogType=IOHWAB_ADC, ArcIoHwAbScalingRef=Voltage_0_5V, ArcIoHwAbAdcChannel=AdcChannel_B36, ArcIoHwAbAdcGroup=HWU1_Background
      ANALOG_A031: ArcIoHwAbAnalogType=IOHWAB_ADC, ArcIoHwAbScalingRef=Voltage_0_5V, ArcIoHwAbAdcChannel=AdcChannel_A31, ArcIoHwAbAdcGroup=HWU2_Background
      ANALOG_B040: ArcIoHwAbAnalogType=IOHWAB_ADC, ArcIoHwAbScalingRef=Voltage_0_5V, ArcIoHwAbAdcChannel=AdcChannel_B40, ArcIoHwAbAdcGroup=HWU2_Background
      ANALOG_A051: ArcIoHwAbAnalogType=IOHWAB_ADC, ArcIoHwAbScalingRef=Voltage_0_5V, ArcIoHwAbAdcChannel=AdcChannel_A51, ArcIoHwAbAdcGroup=HWU2_Background
      ANALOG_B034: ArcIoHwAbAnalogType=IOHWAB_ADC, ArcIoHwAbScalingRef=Voltage_0_5V, ArcIoHwAbAdcChannel=AdcChannel_B34, ArcIoHwAbAdcGroup=HWU2_Background
      ANALOG_B029: ArcIoHwAbAnalogType=IOHWAB_ADC, ArcIoHwAbScalingRef=Voltage_0_5V, ArcIoHwAbAdcChannel=AdcChannel_B29, ArcIoHwAbAdcGroup=HWU3_Background
      VBR_FBK: ArcIoHwAbAnalogType=IOHWAB_ADC, ArcIoHwAbScalingRef=Voltage_0_39V, ArcIoHwAbAdcChannel=AdcChannel_VBAT1, ArcIoHwAbAdcGroup=HWU3_Background
      ANALOG_B026: ArcIoHwAbAnalogType=IOHWAB_ADC, ArcIoHwAbScalingRef=Voltage_0_5V, ArcIoHwAbAdcChannel=AdcChannel_B26, ArcIoHwAbAdcGroup=HWU3_Queued
      ANALOG_B031: ArcIoHwAbAnalogType=IOHWAB_ADC, ArcIoHwAbScalingRef=Voltage_0_5V, ArcIoHwAbAdcChannel=AdcChannel_B31, ArcIoHwAbAdcGroup=HWU4_Background
      ANALOG_A036: ArcIoHwAbAnalogType=IOHWAB_ADC, ArcIoHwAbScalingRef=Voltage_0_5V, ArcIoHwAbAdcChannel=AdcChannel_A36, ArcIoHwAbAdcGroup=HWU4_Background
      ANALOG_B023: ArcIoHwAbAnalogType=IOHWAB_ADC, ArcIoHwAbScalingRef=Voltage_0_5V, ArcIoHwAbAdcChannel=AdcChannel_B23, ArcIoHwAbAdcGroup=HWU4_Queued
      ANALOG_B022: ArcIoHwAbAnalogType=IOHWAB_ADC, ArcIoHwAbScalingRef=Voltage_0_5V, ArcIoHwAbAdcChannel=AdcChannel_B22, ArcIoHwAbAdcGroup=HWU5_Background
      ANALOG_A052: ArcIoHwAbAnalogType=IOHWAB_ADC, ArcIoHwAbScalingRef=Voltage_0_5V, ArcIoHwAbAdcChannel=AdcChannel_A52, ArcIoHwAbAdcGroup=HWU5_Background
      ANALOG_A008: ArcIoHwAbAnalogType=IOHWAB_ADC, ArcIoHwAbScalingRef=Voltage_0_5V, ArcIoHwAbAdcChannel=AdcChannel_A8, ArcIoHwAbAdcGroup=HWU5_Background
      ANALOG_A032: ArcIoHwAbAnalogType=IOHWAB_ADC, ArcIoHwAbScalingRef=Voltage_0_5V, ArcIoHwAbAdcGroup=HWU1_Background, ArcIoHwAbAdcChannel=AdcChannel_A32
      ANALOG_SENT_B042: ArcIoHwAbAnalogType=IOHWAB_EXTERNAL_DEVICE, ArcIoHwAbScalingRef=NoScale, ArcIoHwAbExternalDeviceDriverRef=AnalogSENT
      ANALOG_B054: ArcIoHwAbAnalogType=IOHWAB_ADC, ArcIoHwAbScalingRef=Voltage_0_5V, ArcIoHwAbAdcChannel=AdcChannel_B54, ArcIoHwAbAdcGroup=HWU7_Background
      ANALOG_SENT_B041: ArcIoHwAbAnalogType=IOHWAB_EXTERNAL_DEVICE, ArcIoHwAbScalingRef=NoScale, ArcIoHwAbExternalDeviceDriverRef=AnalogSENT
      ANALOG_A034: ArcIoHwAbAnalogType=IOHWAB_ADC, ArcIoHwAbScalingRef=Voltage_0_5V, ArcIoHwAbAdcChannel=AdcChannel_A34, ArcIoHwAbAdcGroup=HWU4_Background
      ANALOG_A035: ArcIoHwAbAnalogType=IOHWAB_ADC, ArcIoHwAbScalingRef=Voltage_0_5V, ArcIoHwAbAdcChannel=AdcChannel_A35, ArcIoHwAbAdcGroup=HWU6_Background
      ANALOG_B032: ArcIoHwAbAnalogType=IOHWAB_ADC, ArcIoHwAbScalingRef=Voltage_0_5V, ArcIoHwAbAdcChannel=AdcChannel_B32, ArcIoHwAbAdcGroup=HWU3_Background
    DigOutAsDIO_L9788 (ArcIoHwAbExternalDeviceDriver): ArcIoHwAbDigitalSupport=true, ArcIoHwAbAnalogSupport=false, ArcIoHwAbPwmSupport=false
    4 x ArcIoHwAbDigitalSignal, all with ArcIoHwAbDigitalDefaultValue=IOHWAB_LOW, ArcIoHwAbDigitalInverted=false:
      ONOFF_A024: ArcIoHwAbDigitalMethod=IOHWAB_DIGITAL_WRITE, ArcIoHwAbDigitalType=IOHWAB_EXTERNAL_DEVICE, ArcIoHwAbExternalDeviceDriverRef=DigOutAsDIO_L9788
      DI_A075: ArcIoHwAbDigitalMethod=IOHWAB_DIGITAL_READ, ArcIoHwAbDigitalType=IOHWAB_DIO, ArcIoHwAbDioChannelRef=DioChannel_A75
      DI_A053: ArcIoHwAbDigitalMethod=IOHWAB_DIGITAL_READ, ArcIoHwAbDigitalType=IOHWAB_DIO, ArcIoHwAbDioChannelRef=DioChannel_A53
      DI_B021: ArcIoHwAbDigitalMethod=IOHWAB_DIGITAL_READ, ArcIoHwAbDigitalType=IOHWAB_EXTERNAL_DEVICE, ArcIoHwAbExternalDeviceDriverRef=AnalogOutAsDIO
    AnalogOutAsDIO (ArcIoHwAbExternalDeviceDriver): ArcIoHwAbDigitalSupport=true, ArcIoHwAbAnalogSupport=false, ArcIoHwAbPwmSupport=false
    DI_B039 (ArcIoHwAbDigitalSignal):
      ArcIoHwAbDigitalDefaultValue = IOHWAB_LOW
      ArcIoHwAbDigitalInverted = false
      ArcIoHwAbDigitalMethod = IOHWAB_DIGITAL_READ
      ArcIoHwAbDigitalType = IOHWAB_DIO
      ArcIoHwAbDioChannelRef = DioChannel_B39
    DI_B055 (ArcIoHwAbDigitalSignal):
      ArcIoHwAbDigitalDefaultValue = IOHWAB_LOW
      ArcIoHwAbDigitalInverted = false
      ArcIoHwAbDigitalMethod = IOHWAB_DIGITAL_READ
      ArcIoHwAbDigitalType = IOHWAB_DIO
      ArcIoHwAbDioChannelRef = DioChannel_B55
    PWM_A058 (ArcIoHwAbPwmSignal): ArcIoHwAbPwmType=IOHWAB_EXTERNAL_DEVICE_PWM_FREQUENCY_AND_DUTY, ArcIoHwAbPwmDutyDefaultValue=0, ArcIoHwAbExternalDeviceDriverRef=GTM_PWM
    5 x ArcIoHwAbDigitalSignal, all with ArcIoHwAbDigitalDefaultValue=IOHWAB_LOW, ArcIoHwAbDigitalInverted=false:
      ONOFF_A026: ArcIoHwAbDigitalMethod=IOHWAB_DIGITAL_WRITE, ArcIoHwAbDigitalType=IOHWAB_EXTERNAL_DEVICE, ArcIoHwAbExternalDeviceDriverRef=DigOutAsDIO_L9788
      DI_B024: ArcIoHwAbDigitalMethod=IOHWAB_DIGITAL_READ, ArcIoHwAbDigitalType=IOHWAB_EXTERNAL_DEVICE, ArcIoHwAbExternalDeviceDriverRef=AnalogOutAsDIO
      ONOFF_A001: ArcIoHwAbDigitalMethod=IOHWAB_DIGITAL_WRITE, ArcIoHwAbDigitalType=IOHWAB_EXTERNAL_DEVICE, ArcIoHwAbExternalDeviceDriverRef=DigOutAsDIO_L9788
      ONOFF_A003: ArcIoHwAbDigitalMethod=IOHWAB_DIGITAL_WRITE, ArcIoHwAbDigitalType=IOHWAB_EXTERNAL_DEVICE, ArcIoHwAbExternalDeviceDriverRef=DigOutAsDIO_L9788
      DI_A054: ArcIoHwAbDigitalMethod=IOHWAB_DIGITAL_READ, ArcIoHwAbDigitalType=IOHWAB_DIO, ArcIoHwAbDioChannelRef=DioChannel_A54
    3 x ArcIoHwAbAnalogSignal, all with ArcIoHwAbAnalogDefaultValue=0.0, ArcIoHwAbAnalogSignalResolution=12_BIT_RESOLUTION, ArcIoHwAbAnalogType=IOHWAB_EXTERNAL_DEVICE:
      ANALOG_A055: ArcIoHwAbScalingRef=Voltage_0_5V, ArcIoHwAbExternalDeviceDriverRef=DIOAsAnalog
      ANALOG_A056: ArcIoHwAbScalingRef=Voltage_0_5V, ArcIoHwAbExternalDeviceDriverRef=DIOAsAnalog
      BARO: ArcIoHwAbScalingRef=NoScale, ArcIoHwAbExternalDeviceDriverRef=AnalogBARO
    VBK_DIG (ArcIoHwAbDigitalSignal):
      ArcIoHwAbDigitalDefaultValue = IOHWAB_LOW
      ArcIoHwAbDigitalInverted = false
      ArcIoHwAbDigitalMethod = IOHWAB_DIGITAL_READ
      ArcIoHwAbDigitalType = IOHWAB_EXTERNAL_DEVICE
      ArcIoHwAbExternalDeviceDriverRef = DigOutAsDIO_L9788
    6 x ArcIoHwAbPwmSignal, all with ArcIoHwAbPwmType=IOHWAB_EXTERNAL_DEVICE_PWM_FREQUENCY_AND_DUTY, ArcIoHwAbPwmDutyDefaultValue=0, ArcIoHwAbExternalDeviceDriverRef=GTM_PWM:
      PWM_A{040..042}
      PWM_A059
      PWM_A061
      PWM_A062
    ANALOG_B050 (ArcIoHwAbAnalogSignal):
      ArcIoHwAbAnalogDefaultValue = 0.0
      ArcIoHwAbAnalogSignalResolution = 12_BIT_RESOLUTION
      ArcIoHwAbAnalogType = IOHWAB_ADC
      ArcIoHwAbScalingRef = Voltage_0_5V
      ArcIoHwAbAdcChannel = AdcChannel_B50
      ArcIoHwAbAdcGroup = HWU6_Background
    4 x ArcIoHwAbDigitalSignal, all with ArcIoHwAbDigitalDefaultValue=IOHWAB_LOW, ArcIoHwAbDigitalInverted=false:
      ONOFF_A002: ArcIoHwAbDigitalMethod=IOHWAB_DIGITAL_WRITE, ArcIoHwAbDigitalType=IOHWAB_EXTERNAL_DEVICE, ArcIoHwAbExternalDeviceDriverRef=DigOutAsDIO_L9788
      ONOFF_A020: ArcIoHwAbDigitalMethod=IOHWAB_DIGITAL_WRITE, ArcIoHwAbDigitalType=IOHWAB_EXTERNAL_DEVICE, ArcIoHwAbExternalDeviceDriverRef=DigOutAsDIO_L9788
      ONOFF_A039: ArcIoHwAbDigitalMethod=IOHWAB_DIGITAL_WRITE, ArcIoHwAbDigitalType=IOHWAB_EXTERNAL_DEVICE, ArcIoHwAbExternalDeviceDriverRef=DigOutAsDIO_L9788
      DI_B056: ArcIoHwAbDigitalMethod=IOHWAB_DIGITAL_READ, ArcIoHwAbDigitalType=IOHWAB_DIO, ArcIoHwAbDioChannelRef=DioChannel_B56
    DIOAsAnalog (ArcIoHwAbExternalDeviceDriver): ArcIoHwAbDigitalSupport=false, ArcIoHwAbAnalogSupport=true, ArcIoHwAbPwmSupport=false, ArcIoHwAbExternalDeviceAnalogMaxValue=12
    Voltage_0_39V (ArcIoHwAbScaling): ArcIoHwAbScalingOffset=0.0, ArcIoHwAbScalingScale=7.8121212, ArcIoHwAbScalingType=Volt
    3 x ArcIoHwAbAnalogSignal, all with ArcIoHwAbAnalogDefaultValue=0.0, ArcIoHwAbAnalogSignalResolution=12_BIT_RESOLUTION, ArcIoHwAbAnalogType=IOHWAB_EXTERNAL_DEVICE, ArcIoHwAbScalingRef=Voltage_0_5V, ArcIoHwAbExternalDeviceDriverRef=Analog5V:
      TRACK{1..3}_FBK
    PWM_A017 (ArcIoHwAbPwmSignal): ArcIoHwAbPwmType=IOHWAB_EXTERNAL_DEVICE_PWM_FREQUENCY_AND_DUTY, ArcIoHwAbPwmDutyDefaultValue=0, ArcIoHwAbExternalDeviceDriverRef=GTM_PWM
    Analog5V (ArcIoHwAbExternalDeviceDriver): ArcIoHwAbDigitalSupport=false, ArcIoHwAbAnalogSupport=true, ArcIoHwAbPwmSupport=false, ArcIoHwAbExternalDeviceAnalogMaxValue=5
    AnalogSENT (ArcIoHwAbExternalDeviceDriver): ArcIoHwAbDigitalSupport=false, ArcIoHwAbAnalogSupport=true, ArcIoHwAbPwmSupport=false, ArcIoHwAbExternalDeviceAnalogMaxValue=4.096
    4 x ArcIoHwAbPwmSignal, all with ArcIoHwAbPwmType=IOHWAB_EXTERNAL_DEVICE_PWM_FREQUENCY_AND_DUTY, ArcIoHwAbPwmDutyDefaultValue=0, ArcIoHwAbExternalDeviceDriverRef=GTM_PWM:
      PWM_A007
      PWM_A022
      PWM_Y19
      PWM_A023
    ONOFF_A025 (ArcIoHwAbDigitalSignal):
      ArcIoHwAbDigitalDefaultValue = IOHWAB_LOW
      ArcIoHwAbDigitalInverted = false
      ArcIoHwAbDigitalMethod = IOHWAB_DIGITAL_WRITE
      ArcIoHwAbDigitalType = IOHWAB_EXTERNAL_DEVICE
      ArcIoHwAbExternalDeviceDriverRef = DigOutAsDIO_L9788
    DI_A057 (ArcIoHwAbDigitalSignal):
      ArcIoHwAbDigitalDefaultValue = IOHWAB_LOW
      ArcIoHwAbDigitalInverted = false
      ArcIoHwAbDigitalMethod = IOHWAB_DIGITAL_READ
      ArcIoHwAbDigitalType = IOHWAB_DIO
      ArcIoHwAbDioChannelRef = DioChannel_A57
    ANALOG_B037 (ArcIoHwAbAnalogSignal):
      ArcIoHwAbAnalogDefaultValue = 0.0
      ArcIoHwAbAnalogSignalResolution = 12_BIT_RESOLUTION
      ArcIoHwAbAnalogType = IOHWAB_EXTERNAL_DEVICE
      ArcIoHwAbScalingRef = NoScale
      ArcIoHwAbExternalDeviceDriverRef = AnalogSENT
    AnalogBARO (ArcIoHwAbExternalDeviceDriver): ArcIoHwAbDigitalSupport=false, ArcIoHwAbAnalogSupport=true, ArcIoHwAbPwmSupport=false, ArcIoHwAbExternalDeviceAnalogMaxValue=4.096
    DigOutAsDIO (ArcIoHwAbExternalDeviceDriver): ArcIoHwAbDigitalSupport=true, ArcIoHwAbAnalogSupport=false, ArcIoHwAbPwmSupport=false
    ANALOG_A030 (ArcIoHwAbAnalogSignal):
      ArcIoHwAbAnalogDefaultValue = 0.0
      ArcIoHwAbAnalogSignalResolution = 12_BIT_RESOLUTION
      ArcIoHwAbAnalogType = IOHWAB_ADC
      ArcIoHwAbScalingRef = Voltage_0_5V
      ArcIoHwAbAdcChannel = AdcChannel_A30
      ArcIoHwAbAdcGroup = HWU4_Background
    DI_B050 (ArcIoHwAbDigitalSignal):
      ArcIoHwAbDigitalDefaultValue = IOHWAB_LOW
      ArcIoHwAbDigitalInverted = false
      ArcIoHwAbDigitalMethod = IOHWAB_DIGITAL_READ
      ArcIoHwAbDigitalType = IOHWAB_DIO
      ArcIoHwAbDioChannelRef = DioChannel_B50
    ANALOG_IPWM_B050 (ArcIoHwAbAnalogSignal):
      ArcIoHwAbAnalogDefaultValue = 0.0
      ArcIoHwAbAnalogSignalResolution = 12_BIT_RESOLUTION
      ArcIoHwAbAnalogType = IOHWAB_EXTERNAL_DEVICE
      ArcIoHwAbScalingRef = NoScale
      ArcIoHwAbExternalDeviceDriverRef = IPwm
    IPwm (ArcIoHwAbExternalDeviceDriver): ArcIoHwAbDigitalSupport=true, ArcIoHwAbAnalogSupport=true, ArcIoHwAbPwmSupport=false, ArcIoHwAbExternalDeviceAnalogMaxValue=4.096
    DI_A074 (ArcIoHwAbDigitalSignal):
      ArcIoHwAbDigitalDefaultValue = IOHWAB_LOW
      ArcIoHwAbDigitalInverted = false
      ArcIoHwAbDigitalMethod = IOHWAB_DIGITAL_READ
      ArcIoHwAbDigitalType = IOHWAB_DIO
      ArcIoHwAbDioChannelRef = DioChannel_A74
    DI_RST5 (ArcIoHwAbDigitalSignal):
      ArcIoHwAbDigitalDefaultValue = IOHWAB_LOW
      ArcIoHwAbDigitalInverted = false
      ArcIoHwAbDigitalMethod = IOHWAB_DIGITAL_WRITE
      ArcIoHwAbDigitalType = IOHWAB_DIO
      ArcIoHwAbDioChannelRef = DioChannel_RST_MCU_T19
    ANALOG_IPWM_B043 (ArcIoHwAbAnalogSignal):
      ArcIoHwAbAnalogDefaultValue = 0.0
      ArcIoHwAbAnalogSignalResolution = 12_BIT_RESOLUTION
      ArcIoHwAbAnalogType = IOHWAB_EXTERNAL_DEVICE
      ArcIoHwAbScalingRef = NoScale
      ArcIoHwAbExternalDeviceDriverRef = IPwm
    ANALOG_IPWM_B044 (ArcIoHwAbAnalogSignal):
      ArcIoHwAbAnalogDefaultValue = 0.0
      ArcIoHwAbAnalogSignalResolution = 12_BIT_RESOLUTION
      ArcIoHwAbAnalogType = IOHWAB_EXTERNAL_DEVICE
      ArcIoHwAbScalingRef = NoScale
      ArcIoHwAbExternalDeviceDriverRef = IPwm
    3 x ArcIoHwAbPwmSignal, all with ArcIoHwAbPwmType=IOHWAB_EXTERNAL_DEVICE_PWM_FREQUENCY_AND_DUTY, ArcIoHwAbPwmDutyDefaultValue=0, ArcIoHwAbExternalDeviceDriverRef=GTM_PWM:
      PWM_A060
      PWM_A021
      PWM_A005
    ANALOG_A004 (ArcIoHwAbAnalogSignal):
      ArcIoHwAbAnalogDefaultValue = 0.0
      ArcIoHwAbAnalogSignalResolution = 12_BIT_RESOLUTION
      ArcIoHwAbAnalogType = IOHWAB_ADC
      ArcIoHwAbScalingRef = Voltage_0_5V
      ArcIoHwAbAdcChannel = AdcChannel_A4
      ArcIoHwAbAdcGroup = HWU4_Background
    ONOFF_A004 (ArcIoHwAbDigitalSignal):
      ArcIoHwAbDigitalDefaultValue = IOHWAB_LOW
      ArcIoHwAbDigitalInverted = false
      ArcIoHwAbDigitalMethod = IOHWAB_DIGITAL_WRITE
      ArcIoHwAbDigitalType = IOHWAB_EXTERNAL_DEVICE
      ArcIoHwAbExternalDeviceDriverRef = DigOutAsDIO_L9788
    ONOFF_B048 (ArcIoHwAbDigitalSignal):
      ArcIoHwAbDigitalDefaultValue = IOHWAB_LOW
      ArcIoHwAbDigitalInverted = false
      ArcIoHwAbDigitalMethod = IOHWAB_DIGITAL_WRITE
      ArcIoHwAbDigitalType = IOHWAB_DIO
      ArcIoHwAbDioChannelRef = DioChannel_ONOFF_B48
    ANALOG_AN16 (ArcIoHwAbAnalogSignal):
      ArcIoHwAbAnalogDefaultValue = 0.0
      ArcIoHwAbAnalogSignalResolution = 12_BIT_RESOLUTION
      ArcIoHwAbAnalogType = IOHWAB_ADC
      ArcIoHwAbScalingRef = Voltage_0_5V
      ArcIoHwAbAdcChannel = AdcChannel_AN16
      ArcIoHwAbAdcGroup = HWU2_Background
    ONOFF_B058 (ArcIoHwAbDigitalSignal):
      ArcIoHwAbDigitalDefaultValue = IOHWAB_LOW
      ArcIoHwAbDigitalInverted = false
      ArcIoHwAbDigitalMethod = IOHWAB_DIGITAL_WRITE
      ArcIoHwAbDigitalType = IOHWAB_DIO
      ArcIoHwAbDioChannelRef = DioChannel_33_2_ONOFF_B058
    ANALOG_B021 (ArcIoHwAbAnalogSignal):
      ArcIoHwAbAnalogDefaultValue = 0.0
      ArcIoHwAbAnalogSignalResolution = 12_BIT_RESOLUTION
      ArcIoHwAbAnalogType = IOHWAB_ADC
      ArcIoHwAbScalingRef = Voltage_0_5V
      ArcIoHwAbAdcChannel = AdcChannel_B21
      ArcIoHwAbAdcGroup = HWU5_Background
    ONOFF_B074 (ArcIoHwAbDigitalSignal):
      ArcIoHwAbDigitalDefaultValue = IOHWAB_LOW
      ArcIoHwAbDigitalInverted = false
      ArcIoHwAbDigitalMethod = IOHWAB_DIGITAL_WRITE
      ArcIoHwAbDigitalType = IOHWAB_DIO
      ArcIoHwAbDioChannelRef = DioChannel_LSD_B074
